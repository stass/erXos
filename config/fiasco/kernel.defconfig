## config/fiasco/kernel.defconfig
```kconfig
# Copyright (c) 2026, Stanislav Sedov <stas@deglitch.com>
# SPDX-License-Identifier: BSD-2-Clause

CONFIG_ARM=y
CONFIG_PF_ARM_GEN=y
CONFIG_ARM_V8A_GENERIC=y
CONFIG_MP=y
CONFIG_MP_MAX_CPUS=8
CONFIG_DT=y
CONFIG_ARM_PSCI=y
CONFIG_ARM_SMC_USER=y
CONFIG_FPU=y
# CONFIG_ARM_SVE is not set
CONFIG_SYNC_CLOCK=y
CONFIG_PERFORMANCE=y
CONFIG_PERF_CNT_USER=y
CONFIG_EXPERT=y
CONFIG_NO_VERSION=y
# CONFIG_CPU_VIRT is not set
# CONFIG_JDB_DISASM is not set
# CONFIG_JDB_GZIP is not set
# CONFIG_COV is not set
```

## config/fiasco/user.defconfig
```kconfig
# Copyright (c) 2026, Stanislav Sedov <stas@deglitch.com>
# SPDX-License-Identifier: BSD-2-Clause

CONFIG_BUILD_ARCH_arm64=y
CONFIG_PLATFORM_TYPE_arm_virt=y
CONFIG_BID_GENERATE_MAPFILE=y
CONFIG_DRIVERS_FRST_UART_DRV_PL011=y
# CONFIG_DRIVERS_FRST_UART_ALL_DRIVERS is not set
# CONFIG_BID_BUILD_DOC is not set
# CONFIG_BID_BUILD_TESTS is not set
```
